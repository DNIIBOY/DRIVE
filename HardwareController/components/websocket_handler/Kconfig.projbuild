## HardwareController/components/websocket_handler/Kconfig.projbuild
```kconfig
menu "Host-test config"

    config GCOV_ENABLED
        bool "Coverage analyzer"
        default n
        help
            Enables coverage analyzing for host tests.

    config WEBSOCKET_URI
          string "Websocket endpoint URI"
          default "ws://192.168.1.5:5000/ws"
          help
              URL of websocket endpoint this example connects to and sends echo

endmenu
```
